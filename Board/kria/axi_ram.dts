/dts-v1/;
/plugin/;

/ {
    fragment@0 {
        target-path = "/axi";
        __overlay__ {
            axi_ram@80000000 {
                compatible = "generic-uio";
                reg = <0x80000000 0x40000>;
                status = "okay";
				name = "axi_ram";
            };
        };
    };
};
